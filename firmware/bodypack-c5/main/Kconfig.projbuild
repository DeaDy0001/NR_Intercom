## firmware/bodypack-c5/main/Kconfig.projbuild
```kconfig
menu "NR Bodypack"

    menu "Pins (ESP32-C5-Zero)"
        config NRB_PIN_I2C_SDA
            int "I2C SDA (WM8960 SDA)"
            default 9
        config NRB_PIN_I2C_SCL
            int "I2C SCL (WM8960 SCL)"
            default 10
        config NRB_PIN_I2S_BCLK
            int "I2S BCLK (WM8960 CLK, Eingang)"
            default 4
        config NRB_PIN_I2S_WS
            int "I2S WS/LRCLK (WM8960 WS, Eingang)"
            default 5
        config NRB_PIN_I2S_DIN
            int "I2S Daten vom Codec (WM8960 TXSDA)"
            default 6
        config NRB_PIN_I2S_DOUT
            int "I2S Daten zum Codec (WM8960 RXSDA)"
            default 8
        config NRB_PIN_BTN1
            int "Taste 1"
            default 0
        config NRB_PIN_BTN2
            int "Taste 2"
            default 1
        config NRB_PIN_BTN3
            int "Taste 3"
            default 12
        config NRB_PIN_BTN4
            int "Taste 4"
            default 11
        config NRB_PIN_LINK_TX
            int "UART zum S3-Display: TX (-> S3 GPIO10)"
            default 2
        config NRB_PIN_LINK_RX
            int "UART zum S3-Display: RX (<- S3 GPIO4)"
            default 3
        config NRB_PIN_LED
            int "WS2812 RGB-LED"
            default 27
        config NRB_PIN_ANT_SW
            int "Antennen-Umschalter"
            default 26
        config NRB_ANT_EXT_LEVEL
            int "Pegel fuer externe Antenne (IPEX)"
            range 0 1
            default 1
    endmenu

    menu "Standardwerte (koennen per Konsole geaendert werden)"
        config NRB_WIFI_SSID
            string "WLAN SSID"
            default ""
        config NRB_WIFI_PASS
            string "WLAN Passwort"
            default ""
        config NRB_RTP_HOST
            string "RTP-Ziel (IP des Test-PCs)"
            default ""
        config NRB_RTP_PORT
            int "RTP-Zielport"
            default 5006
        config NRB_RTP_LOCAL_PORT
            int "Lokaler RTP-Port"
            default 5004
    endmenu

endmenu
```

## firmware/display-s3/main/Kconfig.projbuild
```kconfig
menu "NR Display"

    menu "AMOLED (RM67162, QSPI)"
        config NRD_LCD_CS
            int "CS"
            default 6
        config NRD_LCD_SCK
            int "SCK"
            default 47
        config NRD_LCD_D0
            int "D0"
            default 18
        config NRD_LCD_D1
            int "D1"
            default 7
        config NRD_LCD_D2
            int "D2"
            default 48
        config NRD_LCD_D3
            int "D3"
            default 5
        config NRD_LCD_RST
            int "Reset (auch Touch-Reset)"
            default 17
        config NRD_LCD_PCLK_MHZ
            int "QSPI-Takt in MHz"
            range 10 80
            default 75
    endmenu

    menu "Drehgeber"
        config NRD_ENC1_CLK
            int "Drehgeber 1 CLK"
            default 11
        config NRD_ENC1_DT
            int "Drehgeber 1 DT"
            default 12
        config NRD_ENC1_SW
            int "Drehgeber 1 SW (Taster)"
            default 13
        config NRD_ENC2_CLK
            int "Drehgeber 2 CLK"
            default 14
        config NRD_ENC2_DT
            int "Drehgeber 2 DT"
            default 16
        config NRD_ENC2_SW
            int "Drehgeber 2 SW (Taster)"
            default 15
        config NRD_ENC_STEPS_PER_DETENT
            int "Zaehlschritte pro Rastung (KY-040: 4)"
            range 1 4
            default 4
        config NRD_ENC_INVERT
            bool "Drehrichtung umkehren"
            default n
    endmenu

    config NRD_BAT_ADC_GPIO
        int "Akkuspannung (Teiler 1:2)"
        default 1

endmenu
```
